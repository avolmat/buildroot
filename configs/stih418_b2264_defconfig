## configs/stih418_b2264_defconfig
```kconfig
BR2_arm=y
BR2_cortex_a9=y
BR2_ARM_ENABLE_NEON=y
BR2_ARM_ENABLE_VFP=y
BR2_TOOLCHAIN_BUILDROOT_CXX=y
BR2_GLOBAL_PATCH_DIR="board/stmicroelectronics/stih418-b2264/patches"
BR2_TARGET_GENERIC_HOSTNAME="4kOpen"
BR2_TARGET_GENERIC_ISSUE="Welcome to Buildroot for the 4kOpen"
BR2_ROOTFS_DEVICE_CREATION_DYNAMIC_EUDEV=y
BR2_SYSTEM_BIN_SH_BASH=y
BR2_SYSTEM_DHCP="eth0"
BR2_TARGET_TZ_INFO=y
BR2_TARGET_TZ_ZONELIST="europe"
BR2_TARGET_LOCALTIME="Europe/Paris"
BR2_ROOTFS_POST_IMAGE_SCRIPT="board/stmicroelectronics/stih418-b2264/post-image.sh"
BR2_LINUX_KERNEL=y
BR2_LINUX_KERNEL_CUSTOM_VERSION=y
BR2_LINUX_KERNEL_CUSTOM_VERSION_VALUE="6.5.2"
BR2_LINUX_KERNEL_USE_CUSTOM_CONFIG=y
BR2_LINUX_KERNEL_CUSTOM_CONFIG_FILE="board/stmicroelectronics/stih418-b2264/linux.config"
BR2_LINUX_KERNEL_UIMAGE=y
BR2_LINUX_KERNEL_UIMAGE_LOADADDR="0x82008000"
BR2_LINUX_KERNEL_DTS_SUPPORT=y
BR2_LINUX_KERNEL_INTREE_DTS_NAME="st/stih418-b2264-box"
BR2_LINUX_KERNEL_NEEDS_HOST_OPENSSL=y
BR2_PACKAGE_BUSYBOX_SHOW_OTHERS=y
BR2_PACKAGE_ALSA_UTILS=y
BR2_PACKAGE_ALSA_UTILS_APLAY=y
BR2_PACKAGE_PLY=y
BR2_PACKAGE_STRACE=y
BR2_PACKAGE_MTD=y
BR2_PACKAGE_GLMARK2=y
BR2_PACKAGE_KMSCUBE=y
BR2_PACKAGE_MESA3D_DEMOS=y
BR2_PACKAGE_FB_TEST_APP=y
BR2_PACKAGE_FBSET=y
BR2_PACKAGE_LIBGLVND=y
BR2_PACKAGE_MESA3D=y
BR2_PACKAGE_MESA3D_GALLIUM_DRIVER_LIMA=y
BR2_PACKAGE_MESA3D_OSMESA_GALLIUM=y
BR2_PACKAGE_MESA3D_OPENGL_EGL=y
BR2_PACKAGE_MESA3D_OPENGL_ES=y
BR2_PACKAGE_SDL2=y
BR2_PACKAGE_SDL2_KMSDRM=y
BR2_PACKAGE_SDL2_OPENGLES=y
BR2_PACKAGE_SDL2_MIXER=y
BR2_PACKAGE_WESTON=y
BR2_PACKAGE_WESTON_DEMO_CLIENTS=y
BR2_PACKAGE_LINUX_FIRMWARE=y
BR2_PACKAGE_LINUX_FIRMWARE_RTL_81XX=y
BR2_PACKAGE_DBUS=y
BR2_PACKAGE_UBOOT_TOOLS=y
BR2_PACKAGE_UBOOT_TOOLS_FIT_SUPPORT=y
BR2_PACKAGE_CA_CERTIFICATES=y
BR2_PACKAGE_LIBDRM_INSTALL_TESTS=y
BR2_PACKAGE_LIBV4L=y
BR2_PACKAGE_LIBV4L_UTILS=y
BR2_PACKAGE_DROPBEAR=y
BR2_PACKAGE_ETHTOOL=y
BR2_PACKAGE_IW=y
BR2_PACKAGE_NTP=y
BR2_PACKAGE_WIRELESS_TOOLS=y
BR2_PACKAGE_WPA_SUPPLICANT=y
BR2_PACKAGE_WPA_SUPPLICANT_CLI=y
BR2_PACKAGE_WPA_SUPPLICANT_WPA_CLIENT_SO=y
BR2_PACKAGE_WPA_SUPPLICANT_PASSPHRASE=y
BR2_PACKAGE_SCREEN=y
BR2_PACKAGE_HTOP=y
BR2_PACKAGE_PROCPS_NG=y
BR2_PACKAGE_SEATD_BUILTIN=y
BR2_PACKAGE_WATCHDOG=y
BR2_TARGET_ROOTFS_EXT2=y
BR2_TARGET_ROOTFS_EXT2_4=y
BR2_TARGET_ROOTFS_EXT2_SIZE="160M"
BR2_PACKAGE_HOST_DOSFSTOOLS=y
BR2_PACKAGE_HOST_ENVIRONMENT_SETUP=y
BR2_PACKAGE_HOST_GENIMAGE=y
BR2_PACKAGE_HOST_MTOOLS=y
```

## configs/stih418_b2264_wayfire_full_defconfig
```kconfig
BR2_arm=y
BR2_cortex_a9=y
BR2_ARM_ENABLE_NEON=y
BR2_ARM_ENABLE_VFP=y
BR2_TOOLCHAIN_BUILDROOT_CXX=y
BR2_GLOBAL_PATCH_DIR="board/stmicroelectronics/stih418-b2264/patches"
BR2_TARGET_GENERIC_HOSTNAME="4kOpen"
BR2_TARGET_GENERIC_ISSUE="Welcome to Buildroot for the 4kOpen"
BR2_ROOTFS_DEVICE_CREATION_DYNAMIC_EUDEV=y
BR2_SYSTEM_BIN_SH_BASH=y
BR2_SYSTEM_DHCP="eth0"
BR2_TARGET_TZ_INFO=y
BR2_TARGET_TZ_ZONELIST="europe"
BR2_TARGET_LOCALTIME="Europe/Paris"
BR2_ROOTFS_OVERLAY="board/stmicroelectronics/stih418-b2264/rootfs_overlay"
BR2_ROOTFS_POST_IMAGE_SCRIPT="board/stmicroelectronics/stih418-b2264/post-image.sh"
BR2_LINUX_KERNEL=y
BR2_LINUX_KERNEL_CUSTOM_VERSION=y
BR2_LINUX_KERNEL_CUSTOM_VERSION_VALUE="6.11.6"
BR2_LINUX_KERNEL_USE_CUSTOM_CONFIG=y
BR2_LINUX_KERNEL_CUSTOM_CONFIG_FILE="board/stmicroelectronics/stih418-b2264/linux.config"
BR2_LINUX_KERNEL_UIMAGE=y
BR2_LINUX_KERNEL_UIMAGE_LOADADDR="0x82008000"
BR2_LINUX_KERNEL_DTS_SUPPORT=y
BR2_LINUX_KERNEL_INTREE_DTS_NAME="st/stih418-b2264-box"
BR2_LINUX_KERNEL_NEEDS_HOST_OPENSSL=y
BR2_PACKAGE_BUSYBOX_SHOW_OTHERS=y
BR2_PACKAGE_ALSA_UTILS=y
BR2_PACKAGE_ALSA_UTILS_APLAY=y
BR2_PACKAGE_MPV=y
BR2_PACKAGE_PLY=y
BR2_PACKAGE_STRACE=y
BR2_PACKAGE_MTD=y
BR2_PACKAGE_LIBERATION=y
BR2_PACKAGE_ADWAITA_ICON_THEME=y
BR2_PACKAGE_HICOLOR_ICON_THEME=y
BR2_PACKAGE_CHOCOLATE_DOOM=y
BR2_PACKAGE_DOOM_WAD=y
BR2_PACKAGE_SUPERTUXKART=y
BR2_PACKAGE_GLMARK2=y
BR2_PACKAGE_KMSCUBE=y
BR2_PACKAGE_MESA3D_DEMOS=y
BR2_PACKAGE_WAYFIRE=y
BR2_PACKAGE_WF_SHELL=y
BR2_PACKAGE_WCM=y
BR2_PACKAGE_ALACRITTY=y
BR2_PACKAGE_FB_TEST_APP=y
BR2_PACKAGE_FBSET=y
BR2_PACKAGE_LIBGLVND=y
BR2_PACKAGE_MESA3D=y
BR2_PACKAGE_MESA3D_GALLIUM_DRIVER_LIMA=y
BR2_PACKAGE_MESA3D_OPENGL_EGL=y
BR2_PACKAGE_MESA3D_OPENGL_ES=y
BR2_PACKAGE_SDL2_WAYLAND=y
BR2_PACKAGE_SDL2_KMSDRM=y
BR2_PACKAGE_SDL2_OPENGLES=y
BR2_PACKAGE_LINUX_FIRMWARE=y
BR2_PACKAGE_LINUX_FIRMWARE_RTL_81XX=y
BR2_PACKAGE_UBOOT_TOOLS=y
BR2_PACKAGE_UBOOT_TOOLS_FIT_SUPPORT=y
BR2_PACKAGE_CA_CERTIFICATES=y
BR2_PACKAGE_LIBDRM_INSTALL_TESTS=y
# BR2_PACKAGE_LIBGTK3_BROADWAY is not set
BR2_PACKAGE_LIBV4L=y
BR2_PACKAGE_LIBV4L_UTILS=y
BR2_PACKAGE_DROPBEAR=y
BR2_PACKAGE_ETHTOOL=y
BR2_PACKAGE_IW=y
BR2_PACKAGE_NTP=y
BR2_PACKAGE_WIRELESS_TOOLS=y
BR2_PACKAGE_WPA_SUPPLICANT=y
BR2_PACKAGE_WPA_SUPPLICANT_CLI=y
BR2_PACKAGE_WPA_SUPPLICANT_WPA_CLIENT_SO=y
BR2_PACKAGE_WPA_SUPPLICANT_PASSPHRASE=y
BR2_PACKAGE_SCREEN=y
BR2_PACKAGE_HTOP=y
BR2_PACKAGE_PROCPS_NG=y
BR2_PACKAGE_WATCHDOG=y
BR2_TARGET_ROOTFS_EXT2=y
BR2_TARGET_ROOTFS_EXT2_4=y
BR2_TARGET_ROOTFS_EXT2_SIZE="1300M"
BR2_PACKAGE_HOST_DOSFSTOOLS=y
BR2_PACKAGE_HOST_ENVIRONMENT_SETUP=y
BR2_PACKAGE_HOST_GENIMAGE=y
BR2_PACKAGE_HOST_MTOOLS=y
```

## package/alacritty/Config.in
```kconfig
config BR2_PACKAGE_ALACRITTY
	bool "alacritty"
	depends on BR2_PACKAGE_HOST_RUSTC_TARGET_ARCH_SUPPORTS
        depends on BR2_PACKAGE_HAS_UDEV
        depends on !BR2_STATIC_LIBS # wayland
        depends on BR2_TOOLCHAIN_HAS_THREADS # wayland
	select BR2_PACKAGE_HOST_RUSTC
        select BR2_PACKAGE_WAYLAND
        select BR2_PACKAGE_WAYLAND_PROTOCOLS
        select BR2_PACKAGE_LIBXKBCOMMON
        select BR2_PACKAGE_FREETYPE
        select BR2_PACKAGE_FONTCONFIG
	help
	  Alacritty is a modern terminal emulator that comes with sensible
	  defaults, but allows for extensive configuration. By integrating
	  with other applications, rather than reimplementing their
	  functionality, it manages to provide a flexible set of features
	  with high performance.

	  https://github.com/alacritty/alacritty.git
```

## package/enigma/Config.in
```kconfig
config BR2_PACKAGE_ENIGMA
	bool "enigma"
	depends on BR2_PACKAGE_SDL2
	depends on BR2_PACKAGE_XERCES
	select BR2_PACKAGE_SDL2_IMAGE
	select BR2_PACKAGE_SDL2_TTF
	select BR2_PACKAGE_SDL2_MIXER

	help
	  Enigma is a unique puzzle game, with influences from almost every game
	  genre.  Your objective is easily explained: you control a small black
	  marble with your mouse and have to find and uncover all pairs of
	  identical Oxyd stones in each landscape.

	  https://github.com/Enigma-Game/Enigma
```

## package/libdbusmenu-gtk/Config.in
```kconfig
config BR2_PACKAGE_LIBDBUSMENU_GTK
	bool "libdbusmenu-gtk"
	depends on !BR2_STATIC_LIBS
	depends on BR2_TOOLCHAIN_HAS_THREADS
	depends on BR2_PACKAGE_HAS_UDEV
	depends on BR2_USE_WCHAR
	depends on BR2_USE_MMU
	depends on BR2_INSTALL_LIBSTDCPP
	depends on BR2_TOOLCHAIN_GCC_AT_LEAST_4_9
	select BR2_PACKAGE_LIBGTK3
	select BR2_PACKAGE_GOBJECT_INTROSPECTION
	select BR2_PACKAGE_PYTHON3
	select BR2_PACKAGE_JSON_GLIB
	help
	  This is a small library designed to make sharing and displaying
	  of menu structures over DBus simple and easy to use. It works
	  for both QT and GTK+ and makes building menus simple.

	  https://launchpad.net/libdbusmenu

comment "libdbusmenu-gtk needs a toolchain w/ wchar, threads, C++, dynamic library, gcc >= 4.9"
	depends on BR2_USE_MMU
	depends on BR2_TOOLCHAIN_HAS_SYNC_4
	depends on !BR2_USE_WCHAR || \
		!BR2_TOOLCHAIN_HAS_THREADS || \
		!BR2_TOOLCHAIN_GCC_AT_LEAST_4_9 || \
		!BR2_INSTALL_LIBSTDCPP || \
		BR2_STATIC_LIBS
```

## package/vkmark/Config.in
```kconfig
config BR2_PACKAGE_VKMARK_FLAVOR_ANY
	bool

config BR2_PACKAGE_VKMARK_FLAVOR_KMS
	bool
	default y if BR2_PACKAGE_HAS_LIBGBM
        select BR2_PACKAGE_VKMARK_FLAVOR_ANY

config BR2_PACKAGE_VKMARK_FLAVOR_WAYLAND
	bool
	default y if BR2_PACKAGE_WAYLAND
	select BR2_PACKAGE_VKMARK_FLAVOR_ANY

config BR2_PACKAGE_VKMARK_FLAVOR_X11
	bool
	default y if BR2_PACKAGE_XORG7
        select BR2_PACKAGE_VKMARK_FLAVOR_ANY

config BR2_PACKAGE_VKMARK
	bool "vkmark"
	depends on BR2_INSTALL_LIBSTDCPP
	depends on BR2_TOOLCHAIN_GCC_AT_LEAST_4_9 # C++14
	depends on BR2_PACKAGE_VKMARK_FLAVOR_ANY
	select BR2_PACKAGE_VULKAN_HEADERS
	select BR2_PACKAGE_VULKAN_LOADER
        depends on !BR2_STATIC_LIBS # vulkan-loader
        depends on BR2_TOOLCHAIN_HAS_THREADS # vulkan-loader
	select BR2_PACKAGE_GLM
        depends on BR2_USE_WCHAR # assimp
        depends on BR2_TOOLCHAIN_GCC_AT_LEAST_7 # assimp
	depends on BR2_INSTALL_LIBSTDCPP # vulkan-loader, glm, assimp, vkmark
	select BR2_PACKAGE_ASSIMP
	select BR2_PACKAGE_WAYLAND_PROTOCOLS if BR2_PACKAGE_VKMARK_FLAVOR_WAYLAND
	select BR2_PACKAGE_LIBXCB if BR2_PACKAGE_VKMARK_FLAVOR_X11
	select BR2_PACKAGE_LIBDRM if BR2_PACKAGE_VKMARK_FLAVOR_KMS
	help
	  vmmark is an Vulkan GPU benchmark.

	  https://github.com/vkmark/vkmark

if BR2_PACKAGE_VKMARK_FLAVOR_ANY

comment "vkmark needs a toolchain w/ C++, dynamic library, threads"
comment "and some form of backend (wayland, xcb or drm)"
	depends on !BR2_INSTALL_LIBSTDCPP || BR2_STATIC_LIBS || \
		!BR2_TOOLCHAIN_HAS_THREADS
endif
```

## package/wayfire/Config.in
```kconfig
config BR2_PACKAGE_WAYFIRE
	bool "wayfire"
	depends on !BR2_STATIC_LIBS # wlroots
	depends on BR2_TOOLCHAIN_HAS_THREADS # pango, wlroots
	depends on BR2_PACKAGE_HAS_LIBEGL # wlroots
	depends on BR2_PACKAGE_HAS_LIBGLES # wlroots
	depends on BR2_PACKAGE_HAS_UDEV # wlroots
	depends on BR2_TOOLCHAIN_HAS_SYNC_4 # pango
	depends on BR2_USE_WCHAR # pango
	depends on BR2_USE_MMU # pango
	depends on BR2_INSTALL_LIBSTDCPP # pango
	depends on BR2_TOOLCHAIN_GCC_AT_LEAST_4_9 # pango
	depends on BR2_TOOLCHAIN_HAS_OPENMP
	select BR2_PACKAGE_WLROOTS
	select BR2_PACKAGE_CAIRO
	select BR2_PACKAGE_CAIRO_PNG
	select BR2_PACKAGE_PANGO
	select BR2_PACKAGE_XKEYBOARD_CONFIG # runtime
	select BR2_PACKAGE_JSON_FOR_MODERN_CPP
	select BR2_PACKAGE_GLM
	select BR2_PACKAGE_SEATD_DAEMON
	help
	  Wayfire Wayland compositor
	  Note:
	    Wayfire is a 3D Wayland compositor, inspired by Compiz and
	    based on wlroots. It aims to create a customizable, extendable
	    and lightweight environment without sacrificing its appearance.

	  https://github.com/WayfireWM/wayfire

comment "Wayfire needs libudev (via systemd or other providers), EGL and OpenGL ES support"
	depends on !BR2_PACKAGE_HAS_LIBEGL || \
		!BR2_PACKAGE_HAS_LIBGLES

comment "wayfire needs a toolchain w/ wchar, threads, C++, dynamic library, gcc >= 4.9"
	depends on BR2_USE_MMU
	depends on BR2_TOOLCHAIN_HAS_SYNC_4
	depends on !BR2_USE_WCHAR || \
		!BR2_TOOLCHAIN_HAS_THREADS || \
		!BR2_TOOLCHAIN_GCC_AT_LEAST_4_9 || \
		!BR2_INSTALL_LIBSTDCPP || \
		BR2_STATIC_LIBS
```

## package/wcm/Config.in
```kconfig
config BR2_PACKAGE_WCM
	bool "wcm"
	depends on !BR2_STATIC_LIBS
	depends on BR2_TOOLCHAIN_HAS_THREADS
	depends on BR2_PACKAGE_HAS_UDEV
	depends on BR2_USE_WCHAR
	depends on BR2_USE_MMU
	depends on BR2_INSTALL_LIBSTDCPP
	depends on BR2_TOOLCHAIN_GCC_AT_LEAST_4_9
	depends on BR2_PACKAGE_WAYFIRE
	select BR2_PACKAGE_LIBGTK3
	select BR2_PACKAGE_GTKMM3
	select BR2_PACKAGE_GOBJECT_INTROSPECTION
	select BR2_PACKAGE_PYTHON3
	select BR2_PACKAGE_LIBRSVG
	help
	  wcm Wayfire Config Manager is a Gtk3 application to configure wayfire.
	  It writes the config file that wayfire reads to update option values.

	  https://github.com/WayfireWM/wcm

comment "wcm needs a toolchain w/ wchar, threads, C++, dynamic library, gcc >= 4.9"
	depends on BR2_USE_MMU
	depends on BR2_TOOLCHAIN_HAS_SYNC_4
	depends on !BR2_USE_WCHAR || \
		!BR2_TOOLCHAIN_HAS_THREADS || \
		!BR2_TOOLCHAIN_GCC_AT_LEAST_4_9 || \
		!BR2_INSTALL_LIBSTDCPP || \
		BR2_STATIC_LIBS
```
